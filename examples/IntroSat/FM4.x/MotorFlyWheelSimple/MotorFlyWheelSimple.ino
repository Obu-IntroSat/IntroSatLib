/* Подключение библиотек */
#include <Wire.h>
#include <MotorFlyWheel.h>
#include <IS_Bluetooth.h>

/* Подключение пространства имён библиотеки,
чтобы постоянно не писать IntroSatLib:: */
using namespace IntroSatLib;

// Создание объекта для управления маховиком
// 0x38 - адрес устройства, может быть другим
MotorFlyWheel motor(Wire, 0x38);

// Создание переменных для задания требуемой и текущей скоростей
int16_t needSpeed = 0;
int16_t curSpeed = 0;

void setup() {
  // Включение Serial для вывода данных
  Serial.begin(115200, SERIAL_8E1);

  // Инициализация Wire - I2C1
  Wire.begin();

  Serial.println("Инициализация платы управления маховиком");
  // Инициализируем катушки в цикле, пока инициализация не пройдёт успешно
  while (motor.Init()) {
    // Выводим символ ".", чтобы наблюдать за инициализацией в мониторе порта.
    Serial.print(".");
    /* Если в мониторе порта продолжают появляться точки,
    проверьте адрес и подключение платы управления маховиком,
    после чего перезагрузите микроконтроллер */
  }

  // Выводим сообщение об успешной инициализации
  Serial.println("\nПлата управления маховиком успешно инициализирована!");
}

// Бесконечный цикл - основной код программы
void loop() {
  // Разгоняем двигатель-маховик против ч.с. до 3000 об/мин

  // В переменной needSpeed задаётся скорость вращения в об/мин
  needSpeed = 3000;
  // Установка требуемой скорости маховика
  motor.NeedSpeed(needSpeed);

  Serial.println("Вращение против часовой стрелки");
  Serial.println("Текущая скорость маховика:");
  /* В цикле считывается реальная текущая скорость маховика, 
  пока она не сравняется с требуемым значением */
  while (curSpeed < 3000) {
    // Вызов метода для получения текущей скорости вращения
    curSpeed = motor.CurrentSpeed();
    // Вывод текущей скорости в монитор порта
    Serial.println(curSpeed);
    // Задержка, чтобы маховик успел разогнаться
    delay(500);
    // Проверяем, не пришёл ли запрос на переход в режим перепрошивки
    if (Serial.available()) {
      if (Serial.read() == 'b') {
        // Если пришёл символ 'b', переходим в режим перепрошивки
        enter_bootloader();
      }
    }
  }

  // Останавливаем маховик

  needSpeed = 0;
  // Для остановки маховика ему необходимо задать скорость 0
  motor.NeedSpeed(needSpeed);
  /* В цикле считывается реальная текущая скорость маховика, 
  пока маховик не будет остановлен */
  Serial.println("Остановка маховика");
  Serial.println("Текущая скорость маховика:");
  while (curSpeed > 0) {
    // Вызов метода для получения текущей скорости вращения
    curSpeed = motor.CurrentSpeed();
    // Вывод текущей скорости в монитор порта
    Serial.println(curSpeed);
    // Задержка, чтобы маховик успел остановиться
    delay(500);
    // Проверяем, не пришёл ли запрос на переход в режим перепрошивки
    if (Serial.available()) {
      if (Serial.read() == 'b') {
        // Если пришёл символ 'b', переходим в режим перепрошивки
        enter_bootloader();
      }
    }
  }

  // Разгоняем двигатель-маховик по ч.с. до 3000 об/мин

  // Чтобы маховик вращался в обратную сторону, используем отрицательные числа
  needSpeed = -3000;
  // Установка требуемой скорости маховика
  motor.NeedSpeed(needSpeed);

  Serial.println("Вращение по часовой стрелке");
  Serial.println("Текущая скорость маховика:");
  /* В цикле считывается реальная текущая скорость маховика, 
  пока она не сравняется с требуемым значением */
  while (curSpeed > -3000) {
    // Вызов метода для получения текущей скорости вращения
    curSpeed = motor.CurrentSpeed();
    // Вывод текущей скорости в монитор порта
    Serial.println(curSpeed);
    // Задержка, чтобы маховик успел остановиться
    delay(500);
    // Проверяем, не пришёл ли запрос на переход в режим перепрошивки
    if (Serial.available()) {
      if (Serial.read() == 'b') {
        // Если пришёл символ 'b', переходим в режим перепрошивки
        enter_bootloader();
      }
    }
  }


  // Останавливаем маховик

  needSpeed = 0;
  // Для остановки маховика ему необходимо задать скорость 0
  motor.NeedSpeed(needSpeed);
  /* В цикле считывается реальная текущая скорость маховика, 
  пока маховик не будет остановлен */
  Serial.println("Остановка маховика");
  Serial.println("Текущая скорость маховика:");
  while (curSpeed > 0) {
    // Вызов метода для получения текущей скорости вращения
    curSpeed = motor.CurrentSpeed();
    // Вывод текущей скорости в монитор порта
    Serial.println(curSpeed);
    // Задержка, чтобы маховик успел остановиться
    delay(500);
    // Проверяем, не пришёл ли запрос на переход в режим перепрошивки
    if (Serial.available()) {
      if (Serial.read() == 'b') {
        // Если пришёл символ 'b', переходим в режим перепрошивки
        enter_bootloader();
      }
    }
  }
}

// Подключение библиотек
#include <Wire.h>
#include <CoilFlyWheel.h>
#include <IS_Bluetooth.h>

/* Подключение пространства имён библиотеки,
чтобы постоянно не писать IntroSatLib:: */
using namespace IntroSatLib;


// Создаём объект для управления магнитными катушками.
// 0x38 - адрес устройства, может быть другим
CoilFlyWheel coil(Wire, 0x38);

void setup()
{
    // Включение Serial для вывода данных
    Serial.begin(115200, SERIAL_8E1);

    // Инициализация Wire - I2C1
    Wire.begin();
    
    Serial.println("Инициализация платы управления катушками");
    // Инициализируем катушки в цикле, пока инициализация не пройдёт успешно
    while (coil.Init())
    {
        // Выводим символ ".", чтобы наблюдать за инициализацией в мониторе порта.
        Serial.print(".");
        /* Если в мониторе порта продолжают появляться точки,
        проверьте адрес и подключение платы управления катушками,
        после чего перезагрузите микроконтроллер. */    
    }
    
    // Выводим сообщение об успешной инициализации
    Serial.println("\nПлата управления катушками успешно инициализирована!");
}

// Бесконечный цикл - основной код программы
void loop()
{
    /* Создаём переменную-счётчик цикла i, регулирующую напряжение на катушках,
    и изменяем её значение в диапазоне от -30000 до +30000 с шагом 5000. */    
    for (int16_t i = -30000; i <= 30000; i += 5000)
    {
        // Вызываем метод для регулирования напряжения на катушках
        coil.NeedSpeed(i);

        // Выводим сообщение о поданном значении
        Serial.print("CoilFlyWheel speed: ");
        Serial.println(i);

        // Проверяем, не пришёл ли запрос на переход в режим перепрошивки
        if (Serial.available())
        {
            if (Serial.read() == 'b')
            {
                // Если пришёл символ 'b', переходим в режим перепрошивки
                enter_bootloader();
            }
        }

        // Задержка в 1 секунду между изменениями напряжения на катушках
        delay(1000);
    }
    // Выводим сообщение-разделитель между циклами изменения напряжения на катушках в мониторе порта
    Serial.println("======================================");
}

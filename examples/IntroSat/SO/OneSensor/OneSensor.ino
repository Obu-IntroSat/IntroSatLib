// Подключение библиотек
#include <Wire.h>
#include <LightSensor.h>
#include <IS_Bluetooth.h>

/**
 * Подключение пространства имён библиотеки,
 * чтобы постоянно не писать IntroSatLib::
 */
using namespace IntroSatLib;

// Задаём понятные имена для возможных адресов датчиков освещённости
#define LS_ADDR_1 0x50
#define LS_ADDR_2 0x51
#define LS_ADDR_3 0x52
#define LS_ADDR_4 0x53

// Создание объекта датчика освещённости по адресу 0x50 (на датчике установлен адрес 1)
LightSensor ls1(Wire, LS_ADDR_1);

void setup()
{
    // Включение Serial для вывода данных
    Serial.begin(115200, SERIAL_8E1);

    // Инициализация Wire - I2C1
    Wire.begin();

    // Инициализация датчика
    uint8_t status = ls1.Init();

    /** Проверка успешной инициализации. 
	 *  	0 - Инициализция успешна
	 *		1-3 - Ошибка инициализации 
	 */
    if (status)
    {
        Serial.print("Ошибка инициализации датчика освещённости! Код ошибки: ");
        Serial.println(status);
        Serial.println("Попробуйте:");
        Serial.println("\t1) установить другой адрес на датчике и изменить адрес в коде объёвления датчика");
        Serial.println("\t2) проверить подключение, попробуйте другой провод");
        Serial.println("\t3) подключить другой датчик освещения");
        // Если датчик не инициализирован - уходим в бесконечный цикл
        while (1)
            ;
    }
}

// Бесконечный цикл - основной код программы
void loop()
{
    // Выводим данные и названия в бесконечном цикле
    Serial.print("light1:");
    Serial.print(ls1.GetLight());
    Serial.print(",");
    
    // Проверяем, не пришёл ли запрос на переход в режим перепрошивки
	if (Serial.available())
	{
		if (Serial.read() == 'b')
		{
			// Если пришёл символ 'b', переходим в режим перепрошивки
			enter_bootloader();
		}
	}

	// Задержка в 100 мс, чтобы данные приходили с небольшим перерывом
	delay(100);
}
